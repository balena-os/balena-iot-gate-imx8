## layers/meta-balena-hab/conf/layer.conf
```bitbake
BBPATH =. "${LAYERDIR}:"
BBFILES += "${LAYERDIR}/recipes-*/*/*.bb \
            ${LAYERDIR}/recipes-*/*/*.bbappend"
BBFILE_COLLECTIONS += "balena-hab"
BBFILE_PATTERN_balena-hab = "^${LAYERDIR}/"
BBFILE_PRIORITY_balena-hab = "1337"
LAYERSERIES_COMPAT_balena-hab = "${LAYERSERIES_COMPAT_core}"

BALENA_NONENC_BOOT_LABEL = "balena-nxp"
```

## layers/meta-balena-imx8mm/conf/layer.conf
```bitbake
BBPATH .= ":${LAYERDIR}"

BBFILES += "${LAYERDIR}/recipes-*/*/*.bb \
            ${LAYERDIR}/recipes-*/*/*.bbappend"

BBFILE_COLLECTIONS += "balena-imx8mm"
BBFILE_PATTERN_balena-imx8mm := "^${LAYERDIR}/"
BBFILE_PRIORITY_balena-imx8mm = "1337"
LAYERSERIES_COMPAT_balena-imx8mm = "kirkstone"

BBMASK += "compulab-ucm-imx8m-mini.bb"
BBMASK += "u-boot-imx-fw-utils_2019.04.bb"
BBMASK += "compulab-qt5-build-env.bb"
BBMASK += "u-boot-fw-utils_%.bbappend"
BBMASK += "meta-compulab/recipes-core/systemd/"
BBMASK += "meta-bsp-imx8mm/recipes-net/sftp"
BBMASK += "meta-bsp-imx8mp/recipes-nxp-demo-experience/nxp-demo-experience"
BBMASK += "meta-compulab-bsp/meta-bsp/recipes-bsp/base-files"
BBMASK += "meta-compulab-bsp/meta-bsp/recipes-bsp/coremark"
BBMASK += "meta-compulab-bsp/meta-bsp/recipes-bsp/systemd"
BBMASK += "meta-compulab-bsp/meta-bsp/recipes-bsp/wpa-supplicant"
BBMASK += "meta-compulab-bsp/meta-bsp/recipes-bsp/u-boot-ai-script"
BBMASK += "meta-compulab-bsp/meta-bsp/recipes-bsp/u-boot-update-scr"
BBMASK += "poky/meta/recipes-connectivity/bluez5/bluez5_5.64.bb"
BBMASK += "meta-bsp-imx8mm/recipes-net"
BBMASK += "meta-compulab-bsp/meta-net"
BBMASK += "meta-compulab/recipes-desktop"
BBMASK += "meta-compulab/classes/compulab.bbclass"
BBMASK += "meta-bsp-imx8mm/recipes-bsp/recipes-images"

CORE_IMAGE_EXTRA_INSTALL:iot-gate-imx8 += " cl-uboot cl-deploy u-boot-script "
CORE_IMAGE_EXTRA_INSTALL:iot-gate-imx8 += " u-boot-fw-utils modemmanager networkmanager linux-firmware-ax200 linux-firmware-ax210"
CORE_IMAGE_EXTRA_INSTALL:remove = "firmware-imx-sdma-imx7d"

KERNEL_IMAGETYPE:iot-gate-imx8 = "Image.gz"

FIRMWARE_COMPRESSION ?= "1"

HOSTTOOLS:remove = " git-lfs "
HOSTTOOLS:remove = " bison "
MACHINE_FEATURES:remove = "optee-os"
MACHINE_FEATURES:remove = "efi"

ROOTFS_POSTPROCESS_COMMAND:remove = "systemd_resolved_fix; "

# This is the version provided by the poky
# revision for the 5.15 kernel revision, as per https://github.com/nxp-imx/imx-manifest/blob/imx-linux-kirkstone/imx-5.15.32-2.0.0.xml
# Can be dropped after updating to a newer kernel which
# is in sync with the wireless regdb provided by Poky
PREFERRED_VERSION:wireless-regdb = "2022.04.08"
```
